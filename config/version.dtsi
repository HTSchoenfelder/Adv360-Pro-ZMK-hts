#define VERSION_MACRO
macro_ver: macro_ver {
compatible = "zmk,behavior-macro";
#binding-cells = <0>;
bindings = <&kp N2>, <&kp N0>, <&kp N2>, <&kp N5>, <&kp N0>, <&kp N8>, <&kp N2>, <&kp N7>, <&kp MINUS>, <&kp C>, <&kp U>, <&kp S>, <&kp T>, <&kp MINUS>, <&kp N1>, <&kp N3>, <&kp F>, <&kp N0>, <&kp N0>, <&kp N9>, <&kp F>, <&kp MINUS>, <&kp C>, <&kp L>, <&kp I>, <&kp Q>, <&kp U>, <&kp E>, <&kp RET>;
};
